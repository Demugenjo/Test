## drivers/regulator/Kconfig.rej
```kconfig
--- drivers/regulator/Kconfig	2018-01-11 15:17:51.000000000 +0700
+++ drivers/regulator/Kconfig	2018-01-28 10:13:04.197182227 +0700
@@ -849,6 +840,13 @@
 	  or decrease requests all the way to the PMIC without software
 	  involvement.
 
+config VOLTAGE_CONTROL
+	bool "Enable CPU voltage control"
+	depends on REGULATOR_CPR3
+	default n
+	help
+	  Enable CPU voltage control for MSM8996.
+
 config REGULATOR_CPR3_HMSS
 	bool "CPR3 regulator for HMSS"
 	depends on OF
```
